## Kconfig.projbuild
```kconfig
menu "mROS Settings"

    ##################################
    #    CHOOSE NETWORK INTERFACE    #
    ##################################
    
    choice
        prompt "mROS network interface select"
        config  M_ROS_ESP_NETIF_WLAN
            bool "WLAN interface"
        config  M_ROS_ESP_NETIF_ENET
            bool "Ethernet interface"
    endchoice
    
    
    #####################
    #    WLAN CONFIG    #
    #####################
    
    if M_ROS_ESP_NETIF_WLAN
    
    menu "WiFi Configuration"
    
        config ESP_WIFI_SSID
            string "WiFi SSID"
            default "myssid"
            help
                SSID (network name) for the example to connect to.
    
        config ESP_WIFI_PASSWORD
            string "WiFi Password"
            default "mypassword"
            help
                WiFi password (WPA or WPA2) for the example to use.
    
        config ESP_MAXIMUM_RETRY
            int "Maximum retry"
            default 5
            help
                Set the Maximum retry to avoid station reconnecting to the AP unlimited when the AP is really inexistent.
    endmenu
    
    endif # M_ROS_ESP_NETIF_WLAN
    
    #########################
    #    ETHERNET CONFIG    #
    #########################
    
    if M_ROS_ESP_NETIF_ENET
    
    menu "Ethernet Configuration"
        config M_ROS_USE_SPI_ETHERNET
            bool
    
        choice M_ROS_ETHERNET_TYPE
            prompt "Ethernet Type"
            default M_ROS_USE_INTERNAL_ETHERNET if IDF_TARGET_ESP32
            default M_ROS_USE_W5500
            help
                Select which kind of Ethernet will be used in the example.
    
            config M_ROS_USE_INTERNAL_ETHERNET
                depends on IDF_TARGET_ESP32
                select ETH_USE_ESP32_EMAC
                bool "Internal EMAC"
                help
                    Select internal Ethernet MAC controller.

            config M_ROS_USE_DM9051
                bool "DM9051 Module"
                select M_ROS_USE_SPI_ETHERNET
                select ETH_USE_SPI_ETHERNET
                select ETH_SPI_ETHERNET_DM9051
                help
                    Select external SPI-Ethernet module (DM9051).
    
            config M_ROS_USE_W5500
                bool "W5500 Module"
                select M_ROS_USE_SPI_ETHERNET
                select ETH_USE_SPI_ETHERNET
                select ETH_SPI_ETHERNET_W5500
                help
                    Select external SPI-Ethernet module (W5500).
        endchoice # M_ROS_ETHERNET_TYPE
    
        if M_ROS_USE_INTERNAL_ETHERNET
            choice M_ROS_ETH_PHY_MODEL
                prompt "Ethernet PHY Device"
                default M_ROS_ETH_PHY_LAN8720
                help
                    Select the Ethernet PHY device to use in the example.
    
                config M_ROS_ETH_PHY_IP101
                    bool "IP101"
                    help
                        IP101 is a single port 10/100 MII/RMII/TP/Fiber Fast Ethernet Transceiver.
                        Goto http://www.icplus.com.tw/pp-IP101G.html for more information about it.
    
                config M_ROS_ETH_PHY_RTL8201
                    bool "RTL8201/SR8201"
                    help
                        RTL8201F/SR8201F is a single port 10/100Mb Ethernet Transceiver with auto MDIX.
                        Goto http://www.corechip-sz.com/productsview.asp?id=22 for more information about it.
    
                config M_ROS_ETH_PHY_LAN8720
                    bool "LAN8720"
                    help
                        LAN8720A is a small footprint RMII 10/100 Ethernet Transceiver with HP Auto-MDIX Support.
                        Goto https://www.microchip.com/LAN8720A for more information about it.
    
                config M_ROS_ETH_PHY_DP83848
                    bool "DP83848"
                    help
                        DP83848 is a single port 10/100Mb/s Ethernet Physical Layer Transceiver.
                        Goto http://www.ti.com/product/DP83848J for more information about it.
    
                config M_ROS_ETH_PHY_KSZ8041
                    bool "KSZ8041"
                    help
                        The KSZ8041 is a single supply 10Base-T/100Base-TX Physical Layer Transceiver.
                        Goto https://www.microchip.com/wwwproducts/en/KSZ8041 for more information about it.
            endchoice # M_ROS_ETH_PHY_MODEL
    
            config M_ROS_ETH_MDC_GPIO
                int "SMI MDC GPIO number"
                default 23
                help
                    Set the GPIO number used by SMI MDC.
    
            config M_ROS_ETH_MDIO_GPIO
                int "SMI MDIO GPIO number"
                default 18
                help
                    Set the GPIO number used by SMI MDIO.
        endif # M_ROS_USE_INTERNAL_ETHERNET
    
        if M_ROS_USE_SPI_ETHERNET
            config M_ROS_ETH_SPI_HOST
                int "SPI Host Number"
                range 0 2
                default 1
                help
                    Set the SPI host used to communicate with the SPI Ethernet Controller.
    
            config M_ROS_ETH_SPI_SCLK_GPIO
                int "SPI SCLK GPIO number"
                range 0 33
                default 20
                help
                    Set the GPIO number used by SPI SCLK.
    
            config M_ROS_ETH_SPI_MOSI_GPIO
                int "SPI MOSI GPIO number"
                range 0 33
                default 19
                help
                    Set the GPIO number used by SPI MOSI.
    
            config M_ROS_ETH_SPI_MISO_GPIO
                int "SPI MISO GPIO number"
                range 0 33
                default 18
                help
                    Set the GPIO number used by SPI MISO.
    
            config M_ROS_ETH_SPI_CS_GPIO
                int "SPI CS GPIO number"
                range 0 33
                default 21
                help
                    Set the GPIO number used by SPI CS.
    
            config M_ROS_ETH_SPI_CLOCK_MHZ
                int "SPI clock speed (MHz)"
                range 5 80
                default 36
                help
                    Set the clock speed (MHz) of SPI interface.
    
            config M_ROS_ETH_SPI_INT_GPIO
                int "Interrupt GPIO number"
                default 4
                help
                    Set the GPIO number used by the SPI Ethernet module interrupt line.
        endif # M_ROS_USE_SPI_ETHERNET
    
        config M_ROS_ETH_PHY_RST_GPIO
            int "PHY Reset GPIO number"
            default -1
            help
                Set the GPIO number used to reset PHY chip.
                Set to -1 to disable PHY chip hardware reset.
    
        config M_ROS_ETH_PHY_ADDR
            int "PHY Address"
            range 0 31
            default 0
            help
                Set PHY address according your board schematic.
    endmenu
    
    endif # M_ROS_ESP_NETIF_ENET
    
    endmenu
```
